## app/Kconfig
```kconfig
menu "Tracker Oracle"

config TRACKER_ORACLE_MODE
	bool "Run the deterministic oracle event sequence instead of the smoke demo"
	default n
	help
     ""

if TRACKER_ORACLE_MODE

config TRACKER_ORACLE_SEED
	int "PRNG seed for the oracle event sequence"
	default 42
	help
	  ""

config TRACKER_ORACLE_N_EVENTS
	int "Number of oracle events to generate"
	default 200

endif # TRACKER_ORACLE_MODE

endmenu

menu "Zephyr Kernel"
source "$ZEPHYR_BASE/Kconfig.zephyr"
endmenu
```

## lib/Kconfig
```kconfig
menu "Libraries"

rsource "common/Kconfig"

choice TRACKER_POLICY
	prompt "Tracker policy implementation"
	default TRACKER_POLICY_BT
	depends on TRACKER_COMMON
	help
		""

rsource "tracker_bt/Kconfig"
rsource "tracker_fsm/Kconfig"

endchoice

endmenu
```

## lib/common/Kconfig
```kconfig
menuconfig TRACKER_COMMON
	bool "Tracker common layer (zbus channels, blackboard, fake drivers)"
	default y
	select ZBUS
	select ZBUS_CHANNEL_NAME
	select ZBUS_RUNTIME_OBSERVERS
	help
		""

if TRACKER_COMMON

config TRACKER_TRACE
	bool "Attach the universal trace probe to every zbus channel"
	default y
	help
		""
config TRACKER_WITH_TAMPER
	bool "Include the tamper/violation-alert behavior"
	default n
	help
		""
endif # TRACKER_COMMON
```

## lib/tracker_fsm/Kconfig
```kconfig
config TRACKER_POLICY_FSM
	bool "Finite State Machine (Zephyr SMF)"
	select SMF
	help
		""
```

## west.yml
```yaml
manifest:
  remotes:
    - name: zephyrproject-rtos
      url-base: https://github.com/zephyrproject-rtos
    - name: vso
      url-base: https://github.com/victorrsoliveira

  projects:
    - name: zephyr
      remote: zephyrproject-rtos
      revision: v4.3.1
      import:
        name-allowlist:
          - cmsis
          - hal_nordic
          - hal_stm32
          - segger
    - name: btreefy
      remote: vso
      revision: main
      path: modules/lib/btreefy
path: .
```
